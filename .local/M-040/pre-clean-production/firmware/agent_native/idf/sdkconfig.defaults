## .local/M-040/pre-clean-production/firmware/agent_native/idf/sdkconfig.defaults
```kconfig
CONFIG_ESP_CONSOLE_UART_DEFAULT=y
CONFIG_ESP_CONSOLE_UART_BAUDRATE=115200
CONFIG_ESP_MAIN_TASK_STACK_SIZE=12288
CONFIG_ESP_WIFI_ESPNOW_MAX_ENCRYPT_NUM=0
CONFIG_ESPTOOLPY_FLASHMODE_DIO=y
CONFIG_ESPTOOLPY_FLASHFREQ_40M=y
CONFIG_ESPTOOLPY_FLASHSIZE_2MB=y
# CONFIG_SPIRAM is not set
```

## simulation/results/2026-11-03-M-016-espnow-host/E1-014/20261103-03-telemetry/source/idf/sdkconfig.defaults
```kconfig
CONFIG_ESP_CONSOLE_UART_DEFAULT=y
CONFIG_ESP_CONSOLE_UART_BAUDRATE=115200
CONFIG_ESP_WIFI_ESPNOW_MAX_ENCRYPT_NUM=0
```

## simulation/results/2026-11-03-M-016-espnow-host/E1-014/20261103-05-frozen/source/idf/main/Kconfig.projbuild
```kconfig
menu "ANN radio bench"
config ANN_CHANNEL
 int "Fixed ESP-NOW channel (all nodes must match)"
 range 1 13
 default 1
endmenu
```

## simulation/results/2026-11-03-M-016-espnow-host/E1-014/20261103-08-c017-reproduce/source/idf/sdkconfig.defaults
```kconfig
CONFIG_ESP_CONSOLE_UART_DEFAULT=y
CONFIG_ESP_CONSOLE_UART_BAUDRATE=115200
CONFIG_ESP_MAIN_TASK_STACK_SIZE=12288
CONFIG_ESP_WIFI_ESPNOW_MAX_ENCRYPT_NUM=0
```
